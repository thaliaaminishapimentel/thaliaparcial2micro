## CMakeLists.txt
```
# Proyecto de Microcontroladores
# Monitor de señal analógica con alarma configurable
# Placa: NXP FRDM-MCXA156

cmake_minimum_required(VERSION 3.22.0)

# Configuración de la placa
set(board frdmmcxa156)
set(board_root examples/_boards)

# Sistema de compilación MCUXpresso SDK
include(${SdkRootDirPath}/cmake/extension/mcux.cmake)

# Definición del proyecto
project(analog_alarm LANGUAGES C CXX ASM
    PROJECT_BOARD_PORT_PATH
    ${board_root}/${board}/driver_examples/lpadc/polling
)

include(${SdkRootDirPath}/CMakeLists.txt)

# Archivos que se incorporarán en las siguientes etapas
mcux_add_source(
    SOURCES
        src/lpadc_polling.c
        src/hardware_init.c
        src/pin_mux.c
        src/app.h
        src/pin_mux.h
        src/alarm_core.h
)

mcux_add_include(INCLUDES src)

# Generación del archivo binario
mcux_convert_binary(
    BINARY ${APPLICATION_BINARY_DIR}/${MCUX_SDK_PROJECT_NAME}.bin
)
```

## prj.conf
```kconfig
# Configuracion de dependencias
# Proyecto FRDM-MCXA156
# Monitor de senal analogica con alarma

# Conversor analogico-digital
CONFIG_MCUX_COMPONENT_driver.lpadc=y

# Temporizador de hardware
CONFIG_MCUX_COMPONENT_driver.ctimer=y

# Entradas y salidas digitales
CONFIG_MCUX_COMPONENT_driver.gpio=y
CONFIG_MCUX_COMPONENT_driver.port=y

# Comunicacion serial UART
CONFIG_MCUX_COMPONENT_driver.lpuart=y

# Reinicio y configuracion de perifericos
CONFIG_MCUX_COMPONENT_driver.reset=y
CONFIG_MCUX_COMPONENT_driver.inputmux=y

# Configuracion manual de pines del proyecto
CONFIG_MCUX_HAS_PRJSEG_project.use_hw_app=n
CONFIG_MCUX_PRJSEG_module.board.pinmux_project_folder=n
CONFIG_MCUX_PRJSEG_module.board.pinmux_board_folder=n
CONFIG_MCUX_HAS_PRJSEG_module.board.pinmux_sel=n
```

## src/adc_control.h
```c
/* SPDX-License-Identifier: MIT */

/*
 * Proyecto: Monitor de senal analogica
 * Placa: FRDM-MCXA156
 *
 * Configuracion del ADC para el potenciometro.
 */

#ifndef ADC_CONTROL_H_
#define ADC_CONTROL_H_

#include <stdint.h>
#include <stdbool.h>

#include "fsl_common.h"
#include "fsl_lpadc.h"

/* Configuracion del ADC */
#define ADC_CONTROL_BASE       ADC1
#define ADC_CONTROL_CANAL      8U
#define ADC_CONTROL_COMANDO    1U

/* Inicializar ADC1 */
static inline void ADC_Control_Iniciar(void)
{
    lpadc_config_t config;
    lpadc_conv_command_config_t comando;
    lpadc_conv_trigger_config_t trigger;

    /* Obtener configuracion predeterminada */
    LPADC_GetDefaultConfig(&config);

#if defined(FSL_FEATURE_LPADC_HAS_CFG_PWRSEL) && \
    (FSL_FEATURE_LPADC_HAS_CFG_PWRSEL == 1U)
    config.powerLevelMode = kLPADC_PowerLevelAlt4;
#endif

    /* Habilitar circuito analogico */
    config.enableAnalogPreliminary = true;

#if !(defined(FSL_FEATURE_LPADC_HAS_CFG_REFSEL) && \
      (FSL_FEATURE_LPADC_HAS_CFG_REFSEL == 0U))
    config.referenceVoltageSource =
        kLPADC_ReferenceVoltageAlt3;
#endif

    /* Inicializar modulo ADC */
    LPADC_Init(ADC_CONTROL_BASE, &config);

    /* Calibracion del ADC */
#if defined(FSL_FEATURE_LPADC_HAS_CTRL_CALOFS) && \
    FSL_FEATURE_LPADC_HAS_CTRL_CALOFS
    LPADC_DoOffsetCalibration(ADC_CONTROL_BASE);
#endif

#if defined(FSL_FEATURE_LPADC_HAS_CTRL_CAL_REQ) && \
    FSL_FEATURE_LPADC_HAS_CTRL_CAL_REQ
    SDK_DelayAtLeastUs(1U, SystemCoreClock);
    LPADC_DoAutoCalibration(ADC_CONTROL_BASE);
#elif defined(FSL_FEATURE_LPADC_HAS_CFG_CALOFS) && \
      FSL_FEATURE_LPADC_HAS_CFG_CALOFS
    SDK_DelayAtLeastUs(1U, SystemCoreClock);
    LPADC_DoAutoCalibration(ADC_CONTROL_BASE);
#endif

    /* Configuracion de conversion */
    LPADC_GetDefaultConvCommandConfig(&comando);

    comando.channelNumber = ADC_CONTROL_CANAL;

    /* Resolucion alta de 16 bits */
    comando.conversionResolutionMode =
        kLPADC_ConversionResolutionHigh;

    LPADC_SetConvCommandConfig(
        ADC_CONTROL_BASE,
        ADC_CONTROL_COMANDO,
        &comando
    );

    /* Configurar disparo por software */
    LPADC_GetDefaultConvTriggerConfig(&trigger);

    trigger.targetCommandId = ADC_CONTROL_COMANDO;
    trigger.enableHardwareTrigger = false;

    LPADC_SetConvTriggerConfig(
        ADC_CONTROL_BASE,
        0U,
        &trigger
    );
}

/* Solicitar una conversion analogica */
static inline void ADC_Control_SolicitarLectura(void)
{
    LPADC_DoSoftwareTrigger(ADC_CONTROL_BASE, 1U);
}

/* Obtener lectura cuando este disponible */
static inline bool ADC_Control_Leer(uint16_t *valor)
{
    lpadc_conv_result_t resultado;
    bool disponible;

#if defined(FSL_FEATURE_LPADC_FIFO_COUNT) && \
    (FSL_FEATURE_LPADC_FIFO_COUNT == 2U)
    disponible = LPADC_GetConvResult(
        ADC_CONTROL_BASE, &resultado, 0U);
#else
    disponible = LPADC_GetConvResult(
        ADC_CONTROL_BASE, &resultado);
#endif

    if (disponible && (valor != NULL))
    {
        *valor = (uint16_t)resultado.convValue;
    }

    return disponible;
}

#endif /* ADC_CONTROL_H_ */
```

## src/alarm_core.h
```c
/* SPDX-License-Identifier: MIT */

/*
 * Proyecto: Monitor de senal analogica
 * Placa: FRDM-MCXA156
 *
 * Conversion ADC, comandos UART,
 * estados RUN/PAUSE, histeresis
 * y antirrebote del pulsador SW2.
 */

#ifndef ALARM_CORE_H
#define ALARM_CORE_H

#include <stdint.h>
#include <stdbool.h>
#include <stddef.h>
#include <string.h>

/* ========================================
 * CONVERSION ADC A PORCENTAJE
 * ======================================== */

static inline uint8_t alarm_pct16(uint16_t adc)
{
    return (uint8_t)(
        ((uint32_t)adc * 100U + 32767U) / 65535U
    );
}

/* ========================================
 * COMANDOS UART
 * ======================================== */

typedef enum
{
    ALARM_CMD_IGNORE,
    ALARM_CMD_STATUS,
    ALARM_CMD_THR,
    ALARM_CMD_START,
    ALARM_CMD_STOP,
    ALARM_CMD_ERR

} alarm_cmd_t;

/* Analizar comandos recibidos por UART */
static inline alarm_cmd_t alarm_parse(
    const char *line,
    uint8_t *new_thr)
{
    unsigned value = 0U;
    size_t i;

    /* Ignorar lineas vacias */
    if (line[0] == '\0')
    {
        return ALARM_CMD_IGNORE;
    }

    /* Comando STATUS */
    if (strcmp(line, "STATUS") == 0)
    {
        return ALARM_CMD_STATUS;
    }

    /* Comando START */
    if (strcmp(line, "START") == 0)
    {
        return ALARM_CMD_START;
    }

    /* Comando STOP */
    if (strcmp(line, "STOP") == 0)
    {
        return ALARM_CMD_STOP;
    }

    /* Verificar formato THR */
    if (strncmp(line, "THR ", 4) != 0)
    {
        return ALARM_CMD_ERR;
    }

    if (line[4] == '\0')
    {
        return ALARM_CMD_ERR;
    }

    /* Convertir caracteres numericos */
    for (i = 4; line[i] != '\0'; ++i)
    {
        if (line[i] < '0' || line[i] > '9')
        {
            return ALARM_CMD_ERR;
        }

        value = value * 10U +
                (unsigned)(line[i] - '0');

        if (value > 95U)
        {
            return ALARM_CMD_ERR;
        }
    }

    if (value < 10U)
    {
        return ALARM_CMD_ERR;
    }

    *new_thr = (uint8_t)value;

    return ALARM_CMD_THR;
}

/* ========================================
 * ESTRUCTURA PRINCIPAL DEL SISTEMA
 * ======================================== */

typedef struct
{
    uint8_t threshold;
    uint8_t percent;
    uint16_t adc;

    bool has_sample;
    bool running;
    bool alarm;
    bool reset_decision;

} alarm_core_t;

/* ========================================
 * INICIALIZACION DEL SISTEMA
 * ======================================== */

static inline void alarm_init(alarm_core_t *c)
{
    c->threshold = 70U;
    c->percent = 0U;
    c->adc = 0U;

    c->has_sample = false;
    c->running = true;
    c->alarm = false;
    c->reset_decision = true;
}

/* ========================================
 * REEVALUACION DE LA ALARMA
 * ======================================== */

static inline void alarm_restart_decision(
    alarm_core_t *c)
{
    if (!c->running)
    {
        c->alarm = false;
        return;
    }

    if (c->has_sample)
    {
        c->alarm =
            (c->percent >= c->threshold);

        c->reset_decision = false;
    }
    else
    {
        c->alarm = false;
        c->reset_decision = true;
    }
}

/* ========================================
 * CONTROL DE ESTADOS RUN Y PAUSE
 * ======================================== */

/* Activar modo RUN */
static inline void alarm_start(alarm_core_t *c)
{
    if (!c->running)
    {
        c->running = true;
        alarm_restart_decision(c);
    }
}

/* Activar modo PAUSE */
static inline void alarm_stop(alarm_core_t *c)
{
    c->running = false;
    c->alarm = false;
}

/* Alternar entre RUN y PAUSE */
static inline void alarm_toggle(alarm_core_t *c)
{
    if (c->running)
    {
        alarm_stop(c);
    }
    else
    {
        alarm_start(c);
    }
}

/* ========================================
 * CAMBIO DEL UMBRAL
 * ======================================== */

static inline void alarm_set_thr(
    alarm_core_t *c,
    uint8_t thr)
{
    c->threshold = thr;
    alarm_restart_decision(c);
}

/* ========================================
 * ACTUALIZACION ADC E HISTERESIS
 * ======================================== */

/*
 * Encender: PCT >= THR
 * Apagar:   PCT < (THR - 5)
 * Retener:  dentro de la banda
 */

static inline void alarm_sample(
    alarm_core_t *c,
    uint16_t adc)
{
    c->adc = adc;
    c->percent = alarm_pct16(adc);
    c->has_sample = true;

    if (!c->running)
    {
        c->alarm = false;
    }
    else if (c->reset_decision)
    {
        alarm_restart_decision(c);
    }
    else if (c->percent >= c->threshold)
    {
        c->alarm = true;
    }
    else if (
        c->percent <
        (uint8_t)(c->threshold - 5U))
    {
        c->alarm = false;
    }

    /* En la banda conserva el estado */
}

/* ========================================
 * ANTIRREBOTE DEL PULSADOR SW2
 * ======================================== */

/*
 * El debounce permite detectar una
 * pulsacion estable durante 30 ms.
 *
 * Cada pulsacion genera una unica accion.
 * Mantener presionado el boton no genera
 * nuevas pulsaciones.
 */

#define ALARM_DEBOUNCE_MS 30U

/* Estructura del pulsador */
typedef struct
{
    bool raw;
    bool stable;
    uint32_t changed_at;

} alarm_debounce_t;

/* Inicializar el sistema de antirrebote */
static inline void alarm_debounce_init(
    alarm_debounce_t *d,
    bool initial_raw)
{
    d->raw = initial_raw;
    d->stable = initial_raw;
    d->changed_at = 0U;
}

/*
 * Procesar el estado del pulsador.
 *
 * pressed:
 * true  = boton presionado
 * false = boton liberado
 *
 * now:
 * tiempo actual en milisegundos.
 *
 * Devuelve true una sola vez cuando
 * se confirma una nueva pulsacion.
 */

static inline bool alarm_debounce_pressed(
    alarm_debounce_t *d,
    bool pressed,
    uint32_t now)
{
    /* Detectar cambio de estado */
    if (pressed != d->raw)
    {
        d->raw = pressed;
        d->changed_at = now;
    }

    /* Verificar estabilidad de 30 ms */
    if (
        (d->raw != d->stable) &&
        ((uint32_t)(now - d->changed_at)
            >= ALARM_DEBOUNCE_MS))
    {
        d->stable = d->raw;

        /* Solo generar evento al presionar */
        return d->stable;
    }

    return false;
}

#endif /* ALARM_CORE_H */
```

## src/app.h
```c
/* SPDX-License-Identifier: MIT */

#ifndef APP_H_
#define APP_H_

/* Inicializacion general del hardware */
void BOARD_InitHardware(void);

#endif /* APP_H_ */
```

## src/hardware_init.c
```c
/* SPDX-License-Identifier: MIT */

/*
 * Proyecto: Monitor de señal analogica
 * Placa: FRDM-MCXA156
 *
 * Inicializacion del hardware principal.
 */

#include "pin_mux.h"
#include "board.h"
#include "clock_config.h"
#include "fsl_clock.h"
#include "fsl_reset.h"

/* Inicializacion de los perifericos */

void BOARD_InitHardware(void)
{
    /* Liberar el modulo ADC1 del reset */
    RESET_ReleasePeripheralReset(kADC1_RST_SHIFT_RSTn);

    /* Configurar reloj del ADC1 a 12 MHz */
    CLOCK_AttachClk(kFRO12M_to_ADC1);

    /* Establecer divisor de reloj */
    CLOCK_SetClockDiv(kCLOCK_DivADC1, 1U);

    /* Inicializar los pines */
    BOARD_InitPins();

    /* Inicializar los relojes principales */
    BOARD_InitBootClocks();

    /* Inicializar la consola de depuracion */
    BOARD_InitDebugConsole();
}
```

## src/led_control.h
```c
/* SPDX-License-Identifier: MIT */

/*
 * Proyecto: Monitor de senal analogica
 * Placa: FRDM-MCXA156
 *
 * Control de LED de actividad y LED de alarma.
 */

#ifndef LED_CONTROL_H_
#define LED_CONTROL_H_

#include <stdbool.h>
#include "fsl_gpio.h"

/* Pines utilizados para los LED */
#define LED_ACTIVIDAD_GPIO GPIO3
#define LED_ACTIVIDAD_PIN  1U

#define LED_ALARMA_GPIO    GPIO3
#define LED_ALARMA_PIN     31U

/* Encender o apagar el LED rojo de actividad */
static inline void LED_Actividad_Escribir(bool encendido)
{
    GPIO_PinWrite(LED_ACTIVIDAD_GPIO,
                  LED_ACTIVIDAD_PIN,
                  encendido ? 1U : 0U);
}

/* Encender o apagar el LED blanco de alarma */
static inline void LED_Alarma_Escribir(bool encendido)
{
    GPIO_PinWrite(LED_ALARMA_GPIO,
                  LED_ALARMA_PIN,
                  encendido ? 1U : 0U);
}

#endif /* LED_CONTROL_H_ */
```

## src/lpadc_polling.c
```c
/* SPDX-License-Identifier: MIT */
/*
 * FRDM-MCXA156 integrated challenge: GPIO + CTIMER1 + ADC1 + LPUART0.
 * Copy this file over NXP's imported lpadc_polling.c, see README.
 * Hardware mappings: A0=J4-2=P1_10/ADC1_A8; SW2=P1_7 (active low),
 * D2=P3_1=activity LED, D4=P3_31=alarm LED, MCU-Link VCOM=LPUART0.
 */
#include <stdint.h>
#include <stdbool.h>
#include <stdio.h>
#include <string.h>

#include "board.h"
#include "app.h"
#include "fsl_common.h"
#include "fsl_clock.h"
#include "fsl_ctimer.h"
#include "fsl_gpio.h"
#include "fsl_lpadc.h"
#include "fsl_lpuart.h"
#include "fsl_reset.h"
#include "alarm_core.h"

#define TICK_TIMER CTIMER1
#define TICK_CLOCK_HZ CLOCK_GetCTimerClkFreq(1U)
#define UART_DEVICE LPUART0
#define UART_IRQn LPUART0_IRQn
#define ACT_LED_PIN 1U           /* GPIO3 / P3_1 -> Arduino D2 (J1-6) */
#define ALARM_LED_PIN 31U        /* GPIO3 / P3_31 -> Arduino D4 (J1-10) */
#define BUTTON_PIN 7U           /* GPIO1 / SW2 */
#define RX_RING_SIZE 256U
#define TX_RING_SIZE 1024U

static volatile uint32_t g_millis;
static volatile uint16_t rx_head, rx_tail, tx_head, tx_tail;
static volatile bool rx_buffer_overflow;
static uint8_t rx_ring[RX_RING_SIZE];
static uint8_t tx_ring[TX_RING_SIZE];
static alarm_core_t alarm;
static alarm_debounce_t debounce;
static bool activity_led;
static bool conversion_pending;

/* CTIMER driver dispatches its MATCH0 IRQ using this callback. */
static void tick_callback(uint32_t flags)
{
    (void)flags;
    ++g_millis;
}
static ctimer_callback_t timer_callbacks[] =
    { tick_callback, NULL, NULL, NULL, NULL, NULL, NULL, NULL };

static void init_timer(void)
{
    ctimer_config_t cfg;
    ctimer_match_config_t match;
    uint32_t timer_hz;

    CLOCK_AttachClk(kFRO_HF_to_CTIMER1);
    CLOCK_SetClockDiv(kCLOCK_DivCTIMER1, 1U);
    RESET_ReleasePeripheralReset(kCTIMER1_RST_SHIFT_RSTn);

    timer_hz = TICK_CLOCK_HZ;
    CTIMER_GetDefaultConfig(&cfg);
    cfg.prescale = 0U; /* / (0+1) = /1; e.g. 96MHz clock. */
    CTIMER_Init(TICK_TIMER, &cfg);
    match.enableCounterReset = true;
    match.enableCounterStop = false;
    match.matchValue = timer_hz / 1000U; /* 96,000 counts -> 1ms at 96MHz. */
    match.outControl = kCTIMER_Output_NoAction;
    match.outPinInitState = false;
    match.enableInterrupt = true;
    CTIMER_RegisterCallBack(TICK_TIMER, timer_callbacks, kCTIMER_MultipleCallback);
    CTIMER_SetupMatch(TICK_TIMER, kCTIMER_Match_0, &match);
    CTIMER_StartTimer(TICK_TIMER);
}

static void init_adc(void)
{
    lpadc_config_t cfg;
    lpadc_conv_command_config_t cmd;
    lpadc_conv_trigger_config_t trigger;

    /* A0: ADC1_A8, externally connected 0..3.3V; N=16, VREF=VDDA. */
    LPADC_GetDefaultConfig(&cfg);
#if defined(FSL_FEATURE_LPADC_HAS_CFG_PWRSEL) && (FSL_FEATURE_LPADC_HAS_CFG_PWRSEL == 1U)
    cfg.powerLevelMode = kLPADC_PowerLevelAlt4;
#endif
    cfg.enableAnalogPreliminary = true;
#if !(defined(FSL_FEATURE_LPADC_HAS_CFG_REFSEL) && (FSL_FEATURE_LPADC_HAS_CFG_REFSEL == 0U))
    cfg.referenceVoltageSource = kLPADC_ReferenceVoltageAlt3;
#endif
    LPADC_Init(ADC1, &cfg);
#if defined(FSL_FEATURE_LPADC_HAS_CTRL_CALOFS) && FSL_FEATURE_LPADC_HAS_CTRL_CALOFS
    LPADC_DoOffsetCalibration(ADC1);
#endif
#if defined(FSL_FEATURE_LPADC_HAS_CTRL_CAL_REQ) && FSL_FEATURE_LPADC_HAS_CTRL_CAL_REQ
    SDK_DelayAtLeastUs(1U, SystemCoreClock); /* one-time init only */
    LPADC_DoAutoCalibration(ADC1);
#elif defined(FSL_FEATURE_LPADC_HAS_CFG_CALOFS) && FSL_FEATURE_LPADC_HAS_CFG_CALOFS
    SDK_DelayAtLeastUs(1U, SystemCoreClock); /* one-time init only */
    LPADC_DoAutoCalibration(ADC1);
#endif

    LPADC_GetDefaultConvCommandConfig(&cmd);
    cmd.channelNumber = 8U;
    cmd.conversionResolutionMode = kLPADC_ConversionResolutionHigh;
    LPADC_SetConvCommandConfig(ADC1, 1U, &cmd);
    LPADC_GetDefaultConvTriggerConfig(&trigger);
    trigger.targetCommandId = 1U;
    trigger.enableHardwareTrigger = false;
    LPADC_SetConvTriggerConfig(ADC1, 0U, &trigger);
}

static void init_uart(void)
{
    lpuart_config_t cfg;
    LPUART_GetDefaultConfig(&cfg);
    cfg.baudRate_Bps = 115200U;
    cfg.parityMode = kLPUART_ParityDisabled;
    cfg.stopBitCount = kLPUART_OneStopBit;
    cfg.enableTx = true;
    cfg.enableRx = true;
    /* This clock was initialized by BOARD_InitDebugConsole() in NXP's base. */
    LPUART_Init(UART_DEVICE, &cfg, BOARD_DEBUG_UART_CLK_FREQ);
    LPUART_EnableInterrupts(UART_DEVICE, kLPUART_RxDataRegFullInterruptEnable);
    EnableIRQ(UART_IRQn);
}

/* Only the UART ISR touches tx_tail/rx_head. No parsing in interrupts. */
void LPUART0_IRQHandler(void)
{
    uint32_t flags = LPUART_GetStatusFlags(UART_DEVICE);
    if ((flags & kLPUART_RxDataRegFullFlag) != 0U)
    {
        uint8_t c = LPUART_ReadByte(UART_DEVICE);
        uint16_t next = (uint16_t)((rx_head + 1U) % RX_RING_SIZE);
        if (next != rx_tail)
        {
            rx_ring[rx_head] = c;
            rx_head = next;
        }
        else
        {
            rx_buffer_overflow = true;
        }
    }
    if ((flags & kLPUART_TxDataRegEmptyFlag) != 0U)
    {
        if (tx_tail != tx_head)
        {
            LPUART_WriteByte(UART_DEVICE, tx_ring[tx_tail]);
            tx_tail = (uint16_t)((tx_tail + 1U) % TX_RING_SIZE);
        }
        else
        {
            LPUART_DisableInterrupts(UART_DEVICE, kLPUART_TxDataRegEmptyInterruptEnable);
        }
    }
    SDK_ISR_EXIT_BARRIER;
}

/* Atomically queue WHOLE lines. TX is sent by the interrupt, never blocking. */
static bool uart_queue(const char *line)
{
    size_t i, len = strlen(line);
    uint16_t free_bytes;
    if (len == 0U || len >= TX_RING_SIZE) return false;
    DisableIRQ(UART_IRQn);
    free_bytes = (uint16_t)((tx_tail + TX_RING_SIZE - tx_head - 1U) % TX_RING_SIZE);
    if (len > free_bytes)
    {
        EnableIRQ(UART_IRQn);
        return false; /* Never send a partial/corrupted line. */
    }
    for (i = 0; i < len; ++i)
    {
        tx_ring[tx_head] = (uint8_t)line[i];
        tx_head = (uint16_t)((tx_head + 1U) % TX_RING_SIZE);
    }
    LPUART_EnableInterrupts(UART_DEVICE, kLPUART_TxDataRegEmptyInterruptEnable);
    EnableIRQ(UART_IRQn);
    return true;
}

static bool uart_pop(uint8_t *c)
{
    if (rx_head == rx_tail) return false;
    *c = rx_ring[rx_tail];
    rx_tail = (uint16_t)((rx_tail + 1U) % RX_RING_SIZE);
    return true;
}

static void write_alarm_led(void)
{
    GPIO_PinWrite(GPIO3, ALARM_LED_PIN, alarm.alarm ? 1U : 0U);
}

static void report_status(void)
{
    char line[96];
    (void)snprintf(line, sizeof(line),
                   "t=%lu;ADC=%u;PCT=%u;THR=%u;MODE=%s;ALARM=%u\r\n",
                   (unsigned long)g_millis, (unsigned)alarm.adc,
                   (unsigned)alarm.percent, (unsigned)alarm.threshold,
                   alarm.running ? "RUN" : "PAUSE", alarm.alarm ? 1U : 0U);
    (void)uart_queue(line);
}

static void handle_command(const char *line)
{
    uint8_t thr = 0;
    char reply[20];
    alarm_cmd_t cmd = alarm_parse(line, &thr);
    switch (cmd)
    {
        case ALARM_CMD_IGNORE: break;
        case ALARM_CMD_STATUS: report_status(); break;
        case ALARM_CMD_START:
            alarm_start(&alarm);
            write_alarm_led();
            (void)uart_queue("OK RUN\r\n");
            break;
        case ALARM_CMD_STOP:
            alarm_stop(&alarm);
            write_alarm_led();
            (void)uart_queue("OK PAUSE\r\n");
            break;
        case ALARM_CMD_THR:
            alarm_set_thr(&alarm, thr);
            write_alarm_led();
            (void)snprintf(reply, sizeof(reply), "OK THR=%u\r\n", (unsigned)thr);
            (void)uart_queue(reply);
            break;
        default: (void)uart_queue("ERR\r\n"); break;
    }
}

static void process_rx(void)
{
    static char line[34]; /* 32 chars + optional CR + NUL */
    static unsigned length;
    static bool dropping;
    uint8_t ch;

    /* When interrupt RX ring has overflowed, resync to the NEXT LF. */
    if (rx_buffer_overflow)
    {
        rx_buffer_overflow = false;
        dropping = true;
    }
    while (uart_pop(&ch))
    {
        if (ch == '\n')
        {
            if (dropping)
            {
                (void)uart_queue("ERR\r\n");
            }
            else
            {
                if ((length > 0U) && (line[length - 1U] == '\r')) --length;
                if (length > 32U) (void)uart_queue("ERR\r\n");
                else
                {
                    line[length] = '\0';
                    handle_command(line);
                }
            }
            length = 0U;
            dropping = false;
        }
        else if (!dropping)
        {
            if (length < 33U) line[length++] = (char)ch;
            else dropping = true;
        }
    }
}

static void receive_adc_if_ready(void)
{
    lpadc_conv_result_t result;
    bool available;
    if (!conversion_pending) return;
#if defined(FSL_FEATURE_LPADC_FIFO_COUNT) && (FSL_FEATURE_LPADC_FIFO_COUNT == 2U)
    available = LPADC_GetConvResult(ADC1, &result, 0U);
#else
    available = LPADC_GetConvResult(ADC1, &result);
#endif
    if (available)
    {
        conversion_pending = false;
        alarm_sample(&alarm, (uint16_t)result.convValue);
        write_alarm_led();
    }
}

int main(void)
{
    uint32_t adc_at = 0U, led_at = 0U, tel_at = 0U;
    BOARD_InitHardware(); /* From NXP example: pins, clock, ADC clock, VCOM. */
    alarm_init(&alarm);
    alarm_debounce_init(&debounce, GPIO_PinRead(GPIO1, BUTTON_PIN) == 0U);
    GPIO_PinWrite(GPIO3, ACT_LED_PIN, 0U);
    GPIO_PinWrite(GPIO3, ALARM_LED_PIN, 0U);
    init_adc();
    init_uart();
    init_timer();

    for (;;)
    {
        uint32_t now = g_millis;
        process_rx(); /* Commands take priority over periodic reports. */
        receive_adc_if_ready();
        if (alarm_debounce_pressed(&debounce,
                                  GPIO_PinRead(GPIO1, BUTTON_PIN) == 0U, now))
        {
            alarm_toggle(&alarm);
            write_alarm_led();
        }
        if ((uint32_t)(now - adc_at) >= 100U)
        {
            adc_at += 100U;
            if (!conversion_pending)
            {
                conversion_pending = true;
                LPADC_DoSoftwareTrigger(ADC1, 1U);
            }
        }
        if ((uint32_t)(now - led_at) >= 500U)
        {
            led_at += 500U;
            activity_led = !activity_led;
            GPIO_PinWrite(GPIO3, ACT_LED_PIN, activity_led ? 1U : 0U);
        }
        if ((uint32_t)(now - tel_at) >= 1000U)
        {
            tel_at += 1000U;
            report_status();
        }
    }
}
```

## src/periodic_tasks.h
```c
/* SPDX-License-Identifier: MIT */

/*
 * Proyecto: Monitor de senal analogica
 * Placa: FRDM-MCXA156
 *
 * Programacion de tareas periodicas
 * mediante una base de tiempo de 1 ms.
 */

#ifndef PERIODIC_TASKS_H_
#define PERIODIC_TASKS_H_

#include <stdint.h>

/* Intervalos de ejecucion en milisegundos */
#define PERIODO_ADC_MS    100U
#define PERIODO_LED_MS    500U
#define PERIODO_UART_MS  1000U

/* Indicadores de tareas pendientes */
#define TAREA_ADC   (1U << 0)
#define TAREA_LED   (1U << 1)
#define TAREA_UART  (1U << 2)

/* Estructura para controlar los tiempos */
typedef struct
{
    uint32_t ultimo_adc;
    uint32_t ultimo_led;
    uint32_t ultimo_uart;

} tareas_periodicas_t;

/* Inicializar los contadores */
static inline void Tareas_Iniciar(
    tareas_periodicas_t *tareas,
    uint32_t tiempo_actual)
{
    tareas->ultimo_adc = tiempo_actual;
    tareas->ultimo_led = tiempo_actual;
    tareas->ultimo_uart = tiempo_actual;
}

/* Comprobar que tareas deben ejecutarse */
static inline uint8_t Tareas_Actualizar(
    tareas_periodicas_t *tareas,
    uint32_t tiempo_actual)
{
    uint8_t pendientes = 0U;

    /* Lectura del ADC cada 100 ms */
    if ((uint32_t)(tiempo_actual -
        tareas->ultimo_adc) >= PERIODO_ADC_MS)
    {
        tareas->ultimo_adc += PERIODO_ADC_MS;
        pendientes |= TAREA_ADC;
    }

    /* Alternar el LED cada 500 ms */
    if ((uint32_t)(tiempo_actual -
        tareas->ultimo_led) >= PERIODO_LED_MS)
    {
        tareas->ultimo_led += PERIODO_LED_MS;
        pendientes |= TAREA_LED;
    }

    /* Transmision UART cada 1000 ms */
    if ((uint32_t)(tiempo_actual -
        tareas->ultimo_uart) >= PERIODO_UART_MS)
    {
        tareas->ultimo_uart += PERIODO_UART_MS;
        pendientes |= TAREA_UART;
    }

    return pendientes;
}

#endif /* PERIODIC_TASKS_H_ */
```

## src/pin_mux.c
```c
/* SPDX-License-Identifier: MIT */

/*
 * Proyecto: Monitor de senal analogica
 * Placa: FRDM-MCXA156
 *
 * Configuracion de pines para GPIO, ADC y UART.
 */

#include "fsl_common.h"
#include "fsl_clock.h"
#include "fsl_reset.h"
#include "fsl_port.h"
#include "fsl_gpio.h"
#include "pin_mux.h"

/* Inicializacion de los pines de arranque */
void BOARD_InitBootPins(void)
{
    BOARD_InitPins();
}

/* Configuracion principal de pines */
void BOARD_InitPins(void)
{
    /* Habilitar relojes GPIO */
    CLOCK_EnableClock(kCLOCK_GateGPIO1);
    CLOCK_EnableClock(kCLOCK_GateGPIO3);

    /* Habilitar relojes PORT */
    CLOCK_EnableClock(kCLOCK_GatePORT0);
    CLOCK_EnableClock(kCLOCK_GatePORT1);
    CLOCK_EnableClock(kCLOCK_GatePORT3);

    /* Liberar perifericos del estado de reset */
    RESET_ReleasePeripheralReset(kGPIO1_RST_SHIFT_RSTn);
    RESET_ReleasePeripheralReset(kGPIO3_RST_SHIFT_RSTn);
    RESET_ReleasePeripheralReset(kLPUART0_RST_SHIFT_RSTn);
    RESET_ReleasePeripheralReset(kADC1_RST_SHIFT_RSTn);

    RESET_ReleasePeripheralReset(kPORT0_RST_SHIFT_RSTn);
    RESET_ReleasePeripheralReset(kPORT1_RST_SHIFT_RSTn);
    RESET_ReleasePeripheralReset(kPORT3_RST_SHIFT_RSTn);

    /* Configuracion de pines UART */
    const port_pin_config_t uart_pin = {
        kPORT_PullUp,
        kPORT_LowPullResistor,
        kPORT_FastSlewRate,
        kPORT_PassiveFilterDisable,
        kPORT_OpenDrainDisable,
        kPORT_LowDriveStrength,
        kPORT_NormalDriveStrength,
        kPORT_MuxAlt2,
        kPORT_InputBufferEnable,
        kPORT_InputNormal,
        kPORT_UnlockRegister
    };

    /* Configuracion de entrada analogica */
    const port_pin_config_t analog_pin = {
        kPORT_PullDisable,
        kPORT_LowPullResistor,
        kPORT_FastSlewRate,
        kPORT_PassiveFilterDisable,
        kPORT_OpenDrainDisable,
        kPORT_LowDriveStrength,
        kPORT_NormalDriveStrength,
        kPORT_MuxAlt0,
        kPORT_InputBufferDisable,
        kPORT_InputNormal,
        kPORT_UnlockRegister
    };

    /* Configuracion de salida digital */
    const port_pin_config_t gpio_out = {
        kPORT_PullDisable,
        kPORT_LowPullResistor,
        kPORT_FastSlewRate,
        kPORT_PassiveFilterDisable,
        kPORT_OpenDrainDisable,
        kPORT_LowDriveStrength,
        kPORT_NormalDriveStrength,
        kPORT_MuxAlt0,
        kPORT_InputBufferEnable,
        kPORT_InputNormal,
        kPORT_UnlockRegister
    };

    /* Configuracion de entrada digital */
    const port_pin_config_t gpio_in = {
        kPORT_PullUp,
        kPORT_LowPullResistor,
        kPORT_FastSlewRate,
        kPORT_PassiveFilterDisable,
        kPORT_OpenDrainDisable,
        kPORT_LowDriveStrength,
        kPORT_NormalDriveStrength,
        kPORT_MuxAlt0,
        kPORT_InputBufferEnable,
        kPORT_InputNormal,
        kPORT_UnlockRegister
    };

    /* Direccion de los GPIO */
    const gpio_pin_config_t led = {
        .pinDirection = kGPIO_DigitalOutput,
        .outputLogic = 0U
    };

    const gpio_pin_config_t sw = {
        .pinDirection = kGPIO_DigitalInput,
        .outputLogic = 0U
    };

    /* UART: comunicacion con MCU-Link */
    PORT_SetPinConfig(PORT0, 2U, &uart_pin);
    PORT_SetPinConfig(PORT0, 3U, &uart_pin);

    /* ADC: potenciometro conectado a A0 */
    PORT_SetPinConfig(PORT1, 10U, &analog_pin);

    /* SW2: pulsador integrado */
    PORT_SetPinConfig(PORT1, 7U, &gpio_in);

    /* LED rojo: indicador de actividad */
    PORT_SetPinConfig(PORT3, 1U, &gpio_out);

    /* LED blanco: indicador de alarma */
    PORT_SetPinConfig(PORT3, 31U, &gpio_out);

    /* Inicializar GPIO */
    GPIO_PinInit(GPIO1, 7U, &sw);
    GPIO_PinInit(GPIO3, 1U, &led);
    GPIO_PinInit(GPIO3, 31U, &led);
}
```

## src/pin_mux.h
```c
/* SPDX-License-Identifier: MIT */

#ifndef PIN_MUX_H_
#define PIN_MUX_H_

#ifdef __cplusplus
extern "C" {
#endif

/* Inicializacion de los pines de la placa */
void BOARD_InitBootPins(void);

/* Configuracion de pines y perifericos */
void BOARD_InitPins(void);

#ifdef __cplusplus
}
#endif

#endif /* PIN_MUX_H_ */
```

## src/timer_control.h
```c
/* SPDX-License-Identifier: MIT */

/*
 * Proyecto: Monitor de senal analogica
 * Placa: FRDM-MCXA156
 *
 * Temporizador CTIMER1 con interrupcion
 * para generar una base de tiempo de 1 ms.
 */

#ifndef TIMER_CONTROL_H_
#define TIMER_CONTROL_H_

#include <stdint.h>
#include <stddef.h>

#include "fsl_clock.h"
#include "fsl_reset.h"
#include "fsl_ctimer.h"

/* Temporizador utilizado */
#define TIMER_CONTROL_BASE CTIMER1

/* Contador de milisegundos */
static volatile uint32_t timer_milisegundos = 0U;

/* Funcion ejecutada en cada interrupcion */
static void Timer_Control_Callback(uint32_t flags)
{
    (void)flags;

    timer_milisegundos++;
}

/* Tabla de funciones callback */
static ctimer_callback_t timer_callbacks[] = {
    Timer_Control_Callback,
    NULL,
    NULL,
    NULL,
    NULL,
    NULL,
    NULL,
    NULL
};

/* Inicializar el temporizador CTIMER1 */
static inline void Timer_Control_Iniciar(void)
{
    ctimer_config_t config;
    ctimer_match_config_t match;

    uint32_t frecuencia_timer;

    /* Seleccionar reloj FRO_HF */
    CLOCK_AttachClk(kFRO_HF_to_CTIMER1);

    /* Configurar divisor del reloj */
    CLOCK_SetClockDiv(kCLOCK_DivCTIMER1, 1U);

    /* Liberar CTIMER1 del reset */
    RESET_ReleasePeripheralReset(
        kCTIMER1_RST_SHIFT_RSTn
    );

    /* Consultar frecuencia del temporizador */
    frecuencia_timer = CLOCK_GetCTimerClkFreq(1U);

    /* Configuracion predeterminada */
    CTIMER_GetDefaultConfig(&config);

    /* Prescaler igual a cero */
    config.prescale = 0U;

    /* Inicializar CTIMER1 */
    CTIMER_Init(TIMER_CONTROL_BASE, &config);

    /* Configurar evento cada 1 ms */
    match.enableCounterReset = true;
    match.enableCounterStop = false;

    match.matchValue = frecuencia_timer / 1000U;

    match.outControl = kCTIMER_Output_NoAction;
    match.outPinInitState = false;

    /* Habilitar interrupciones */
    match.enableInterrupt = true;

    /* Registrar callback */
    CTIMER_RegisterCallBack(
        TIMER_CONTROL_BASE,
        timer_callbacks,
        kCTIMER_MultipleCallback
    );

    /* Configurar MATCH0 */
    CTIMER_SetupMatch(
        TIMER_CONTROL_BASE,
        kCTIMER_Match_0,
        &match
    );

    /* Iniciar el temporizador */
    CTIMER_StartTimer(TIMER_CONTROL_BASE);
}

/* Obtener el tiempo transcurrido en milisegundos */
static inline uint32_t Timer_Control_Millis(void)
{
    return timer_milisegundos;
}

#endif /* TIMER_CONTROL_H_ */
```

## src/uart_control.h
```c
/* SPDX-License-Identifier: MIT */

/*
 * Proyecto: Monitor de senal analogica
 * Placa: FRDM-MCXA156
 *
 * Configuracion de comunicacion UART.
 */

#ifndef UART_CONTROL_H_
#define UART_CONTROL_H_

#include <stdint.h>

#include "board.h"
#include "fsl_common.h"
#include "fsl_lpuart.h"

/* Periferico UART utilizado */
#define UART_CONTROL_BASE LPUART0

/* Configuracion de comunicacion */
#define UART_CONTROL_BAUDRATE 115200U

/* Inicializar el modulo UART */
static inline void UART_Control_Iniciar(void)
{
    lpuart_config_t config;

    /* Obtener configuracion predeterminada */
    LPUART_GetDefaultConfig(&config);

    /* Velocidad de comunicacion */
    config.baudRate_Bps = UART_CONTROL_BAUDRATE;

    /* Comunicacion sin paridad */
    config.parityMode = kLPUART_ParityDisabled;

    /* Un bit de parada */
    config.stopBitCount = kLPUART_OneStopBit;

    /* Habilitar transmision y recepcion */
    config.enableTx = true;
    config.enableRx = true;

    /* Inicializar LPUART0 */
    LPUART_Init(
        UART_CONTROL_BASE,
        &config,
        BOARD_DEBUG_UART_CLK_FREQ
    );
}

/*
 * Habilitar interrupcion de recepcion.
 *
 * Esta funcion se utilizara cuando agreguemos
 * el controlador de interrupciones UART.
 */
static inline void UART_Control_HabilitarRX(void)
{
    LPUART_EnableInterrupts(
        UART_CONTROL_BASE,
        kLPUART_RxDataRegFullInterruptEnable
    );

    EnableIRQ(LPUART0_IRQn);
}

#endif /* UART_CONTROL_H_ */
```
